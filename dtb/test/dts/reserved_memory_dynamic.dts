/dts-v1/;

/ {
    #address-cells = <2>;
    #size-cells = <1>;

    reserved-memory {
        #address-cells = <2>;
        #size-cells = <1>;

        linux_cma: cma@0 {
            compatible = "shared-dma-pool";
            reusable;
            size = <0x00010000>;          // 64 KiB
            alignment = <0x00010000>;     // 64 KiB alignment
            /* allowed allocation range: [0x4000_0000, 0x4000_0000 + 0x1000_0000) */
            alloc-ranges = <0x0 0x40000000 0x10000000>;
        };
    };
};

